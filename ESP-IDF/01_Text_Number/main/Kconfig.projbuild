## examples/esp-idf/LCD_05_Clock/sdkconfig.defaults
```kconfig
CONFIG_CODEC_I2C_BACKWARD_COMPATIBLE=n
CONFIG_IDF_CMAKE=y
CONFIG_IDF_TARGET_ARCH_XTENSA=y


CONFIG_FREERTOS_ENABLE_BACKWARD_COMPATIBILITY=y

CONFIG_SPIRAM=y
CONFIG_SPIRAM_MODE_OCT=y
CONFIG_SPIRAM_SPEED_80M=y
CONFIG_SPIRAM_BOOT_INIT=y
CONFIG_SPIRAM_USE_MALLOC=y
CONFIG_SPIRAM_ALLOW_STACK_EXTERNAL_MEMORY=y

CONFIG_LV_USE_USER_DATA=y
CONFIG_LV_USE_CHART=y
#CONFIG_LV_USE_PERF_MONITOR=y
CONFIG_ESP32S3_DATA_CACHE_LINE_64B=y
CONFIG_ESP32S3_DATA_CACHE_LINE_SIZE=64

CONFIG_FATFS_LFN_STACK=y
CONFIG_FATFS_MAX_LFN=255
CONFIG_FATFS_API_ENCODING_ANSI_OEM=y
CONFIG_ESPTOOLPY_FLASHSIZE_16MB=y
CONFIG_PARTITION_TABLE_CUSTOM=y
CONFIG_PARTITION_TABLE_CUSTOM_FILENAME="partitions.csv"
CONFIG_ESP_TLS_INSECURE=y
CONFIG_ESP_TLS_SKIP_SERVER_CERT_VERIFY=y

#CONFIG_LV_USE_MEM_MONITOR=n
#CONFIG_LWIP_WND_SCALE=n
CONFIG_LV_MEM_CUSTOM=y
CONFIG_LV_MEM_CUSTOM_INCLUDE="stdlib.h"
#or
#CONFIG_SPIRAM_USE_CAPS_ALLOC=y
#CONFIG_LV_MEM_SIZE_KILOBYTES=48



CONFIG_ESP_DEFAULT_CPU_FREQ_MHZ_240=y
CONFIG_LV_COLOR_16_SWAP=y
CONFIG_LV_USE_DEMO_WIDGETS=y
CONFIG_LV_DEMO_WIDGETS_SLIDESHOW=y
CONFIG_LV_USE_DEMO_KEYPAD_AND_ENCODER=y
CONFIG_LV_USE_DEMO_BENCHMARK=y
CONFIG_LV_USE_DEMO_STRESS=y
CONFIG_LV_USE_DEMO_MUSIC=y
CONFIG_LV_FONT_MONTSERRAT_12=y
CONFIG_LV_FONT_MONTSERRAT_14=y
CONFIG_LV_FONT_MONTSERRAT_16=y
CONFIG_LV_USE_FS_FATFS=n
CONFIG_LV_FS_FATFS_LETTER=0
CONFIG_LV_FS_FATFS_PATH=""
CONFIG_LV_USE_PNG=y
CONFIG_LV_USE_GIF=y

#CONFIG_FREERTOS_HZ=1000


#CONFIG_IDF_EXPERIMENTAL_FEATURES=y
#CONFIG_ESPTOOLPY_FLASHFREQ_120M=y
#CONFIG_SPI_FLASH_UNDER_HIGH_FREQ=y
#CONFIG_SPIRAM_SPEED_120M=y
#CONFIG_SPIRAM_SPEED=120

#CONFIG_SPIRAM_FETCH_INSTRUCTIONS=y
#CONFIG_SPIRAM_RODATA=y
CONFIG_SPIRAM_USE_MALLOC=y
#CONFIG_SPIRAM_MALLOC_ALWAYSINTERNAL=16384
#CONFIG_SPIRAM_MALLOC_RESERVE_INTERNAL=32768
#CONFIG_ESP32S3_DATA_CACHE_LINE_64B=y
#CONFIG_COMPILER_OPTIMIZATION_PERF=y
########################################################################################
#############################################################################################
CONFIG_ESP_CONSOLE_USB_SERIAL_JTAG=y
CONFIG_FLASHMODE_QIO=y
CONFIG_ESP32S3_DATA_CACHE_64KB=y
CONFIG_ESP32S3_DATA_CACHE_SIZE=0x20000

#
# Use WIFI when PSRAM is enabled
#
CONFIG_SPIRAM_TRY_ALLOCATE_WIFI_LWIP=y
CONFIG_ESP_WIFI_STATIC_RX_BUFFER_NUM=10
CONFIG_ESP_WIFI_RX_BA_WIN=6
CONFIG_LWIP_TCP_OOSEQ_MAX_PBUFS=4
CONFIG_ESP32_WIFI_RX_BA_WIN=6
CONFIG_ESP32_WIFI_RX_BA_WIN=6

CONFIG_OPENTHREAD_RX_ON_WHEN_IDLE=y


#
# BLE Configuration
#
#CONFIG_BT_ENABLED=y
#CONFIG_BT_BLE_50_FEATURES_SUPPORTED=y
#CONFIG_BT_BLE_42_FEATURES_SUPPORTED=y





#
# I2S Configuration
#
CONFIG_I2S_ISR_IRAM_SAFE=y
CONFIG_I2S_SUPPRESS_DEPRECATE_WARN=y
CONFIG_I2S_ENABLE_DEBUG_LOG=y
#
# ESP Speech Recognition
#
CONFIG_MODEL_IN_SPIFFS=y
# CONFIG_MODEL_IN_SDCARD is not set
CONFIG_USE_AFE=y
CONFIG_AFE_INTERFACE_V1=y
CONFIG_USE_WAKENET=y
# CONFIG_SR_WN_WN8_ALEXA is not set
# CONFIG_SR_WN_WN9_HILEXIN=y
# CONFIG_SR_WN_WN9_XIAOAITONGXUE is not set
# CONFIG_SR_WN_WN9_ALEXA is not set
# CONFIG_SR_WN_WN9_HIESP is not set
# CONFIG_SR_WN_WN9_HIMFIVE is not set
# CONFIG_SR_WN_WN9_NIHAOXIAOZHI is not set
# CONFIG_SR_WN_WN9_CUSTOMWORD is not set
# CONFIG_SR_WN_LOAD_MULIT_WORD is not set
CONFIG_USE_MULTINET=y

#
# Chinese speech
#
#CONFIG_SR_WN_WN9_HILEXIN=y
#CONFIG_SR_MN_EN_NONE=y
#CONFIG_SR_MN_CN_MULTINET5_RECOGNITION_QUANT8=y
# CONFIG_SR_MN_CN_MULTINET6_QUANT is not set
# CONFIG_SR_MN_CN_MULTINET6_AC_QUANT is not set

#
# English speech
#
CONFIG_SR_WN_WN9_HIESP=y
CONFIG_SR_MN_CN_NONE=y
CONFIG_SR_MN_EN_MULTINET5_SINGLE_RECOGNITION_QUANT8=y
# CONFIG_SR_MN_EN_MULTINET6_QUANT is not set
# CONFIG_SR_MN_EN_MULTINET7_QUANT is not set

#
# Add Chinese speech commands
#
CONFIG_CN_SPEECH_COMMAND_ID0="bei guang zui liang"
CONFIG_CN_SPEECH_COMMAND_ID1="bei guang zui an"
CONFIG_CN_SPEECH_COMMAND_ID2="guan bi bei guang"
CONFIG_CN_SPEECH_COMMAND_ID3="da kai bei guang"
CONFIG_CN_SPEECH_COMMAND_ID4="bo fang yin yue"
CONFIG_CN_SPEECH_COMMAND_ID5=""
CONFIG_CN_SPEECH_COMMAND_ID6=""
CONFIG_CN_SPEECH_COMMAND_ID6=""
CONFIG_CN_SPEECH_COMMAND_ID7=""
CONFIG_CN_SPEECH_COMMAND_ID8=""
CONFIG_CN_SPEECH_COMMAND_ID9=""
CONFIG_CN_SPEECH_COMMAND_ID10=""
CONFIG_CN_SPEECH_COMMAND_ID11=""
CONFIG_CN_SPEECH_COMMAND_ID12=""
CONFIG_CN_SPEECH_COMMAND_ID13=""
CONFIG_CN_SPEECH_COMMAND_ID14=""
CONFIG_CN_SPEECH_COMMAND_ID15=""
CONFIG_CN_SPEECH_COMMAND_ID16=""
CONFIG_CN_SPEECH_COMMAND_ID17=""
CONFIG_CN_SPEECH_COMMAND_ID18=""
CONFIG_CN_SPEECH_COMMAND_ID19=""
CONFIG_CN_SPEECH_COMMAND_ID20=""
CONFIG_CN_SPEECH_COMMAND_ID21=""
CONFIG_CN_SPEECH_COMMAND_ID22=""
CONFIG_CN_SPEECH_COMMAND_ID23=""
CONFIG_CN_SPEECH_COMMAND_ID24=""
CONFIG_CN_SPEECH_COMMAND_ID25=""
CONFIG_CN_SPEECH_COMMAND_ID26=""
CONFIG_CN_SPEECH_COMMAND_ID27=""
CONFIG_CN_SPEECH_COMMAND_ID28=""
CONFIG_CN_SPEECH_COMMAND_ID29=""
CONFIG_CN_SPEECH_COMMAND_ID30=""
CONFIG_CN_SPEECH_COMMAND_ID31=""
CONFIG_CN_SPEECH_COMMAND_ID32=""
CONFIG_CN_SPEECH_COMMAND_ID33=""
CONFIG_CN_SPEECH_COMMAND_ID34=""
CONFIG_CN_SPEECH_COMMAND_ID35=""
CONFIG_CN_SPEECH_COMMAND_ID36=""
CONFIG_CN_SPEECH_COMMAND_ID37=""
CONFIG_CN_SPEECH_COMMAND_ID38=""
CONFIG_CN_SPEECH_COMMAND_ID39=""
CONFIG_CN_SPEECH_COMMAND_ID40=""
CONFIG_CN_SPEECH_COMMAND_ID41=""
CONFIG_CN_SPEECH_COMMAND_ID42=""
CONFIG_CN_SPEECH_COMMAND_ID43=""
CONFIG_CN_SPEECH_COMMAND_ID44=""
CONFIG_CN_SPEECH_COMMAND_ID45=""
CONFIG_CN_SPEECH_COMMAND_ID46=""
CONFIG_CN_SPEECH_COMMAND_ID47=""
CONFIG_CN_SPEECH_COMMAND_ID48=""
CONFIG_CN_SPEECH_COMMAND_ID49=""
CONFIG_CN_SPEECH_COMMAND_ID50=""
CONFIG_CN_SPEECH_COMMAND_ID51=""
CONFIG_CN_SPEECH_COMMAND_ID52=""
CONFIG_CN_SPEECH_COMMAND_ID53=""
CONFIG_CN_SPEECH_COMMAND_ID54=""
CONFIG_CN_SPEECH_COMMAND_ID55=""
CONFIG_CN_SPEECH_COMMAND_ID56=""
CONFIG_CN_SPEECH_COMMAND_ID57=""
CONFIG_CN_SPEECH_COMMAND_ID58=""
CONFIG_CN_SPEECH_COMMAND_ID59=""
CONFIG_CN_SPEECH_COMMAND_ID60=""
CONFIG_CN_SPEECH_COMMAND_ID61=""
CONFIG_CN_SPEECH_COMMAND_ID62=""
CONFIG_CN_SPEECH_COMMAND_ID63=""
CONFIG_CN_SPEECH_COMMAND_ID64=""
CONFIG_CN_SPEECH_COMMAND_ID65=""
CONFIG_CN_SPEECH_COMMAND_ID66=""
CONFIG_CN_SPEECH_COMMAND_ID67=""
CONFIG_CN_SPEECH_COMMAND_ID68=""
CONFIG_CN_SPEECH_COMMAND_ID69=""
CONFIG_CN_SPEECH_COMMAND_ID70=""
CONFIG_CN_SPEECH_COMMAND_ID71=""
CONFIG_CN_SPEECH_COMMAND_ID72=""
CONFIG_CN_SPEECH_COMMAND_ID73=""
CONFIG_CN_SPEECH_COMMAND_ID74=""
CONFIG_CN_SPEECH_COMMAND_ID75=""
CONFIG_CN_SPEECH_COMMAND_ID76=""
CONFIG_CN_SPEECH_COMMAND_ID77=""
CONFIG_CN_SPEECH_COMMAND_ID78=""
CONFIG_CN_SPEECH_COMMAND_ID79=""
CONFIG_CN_SPEECH_COMMAND_ID80=""
CONFIG_CN_SPEECH_COMMAND_ID81=""
CONFIG_CN_SPEECH_COMMAND_ID82=""
CONFIG_CN_SPEECH_COMMAND_ID83=""
CONFIG_CN_SPEECH_COMMAND_ID84=""
CONFIG_CN_SPEECH_COMMAND_ID85=""
CONFIG_CN_SPEECH_COMMAND_ID86=""
CONFIG_CN_SPEECH_COMMAND_ID87=""
CONFIG_CN_SPEECH_COMMAND_ID88=""
CONFIG_CN_SPEECH_COMMAND_ID89=""
CONFIG_CN_SPEECH_COMMAND_ID90=""
CONFIG_CN_SPEECH_COMMAND_ID91=""
CONFIG_CN_SPEECH_COMMAND_ID92=""
CONFIG_CN_SPEECH_COMMAND_ID93=""
CONFIG_CN_SPEECH_COMMAND_ID94=""
CONFIG_CN_SPEECH_COMMAND_ID95=""
CONFIG_CN_SPEECH_COMMAND_ID96=""
CONFIG_CN_SPEECH_COMMAND_ID97=""
CONFIG_CN_SPEECH_COMMAND_ID98=""
CONFIG_CN_SPEECH_COMMAND_ID99=""
CONFIG_CN_SPEECH_COMMAND_ID100=""
CONFIG_CN_SPEECH_COMMAND_ID101=""
CONFIG_CN_SPEECH_COMMAND_ID102=""
CONFIG_CN_SPEECH_COMMAND_ID103=""
CONFIG_CN_SPEECH_COMMAND_ID104=""
CONFIG_CN_SPEECH_COMMAND_ID105=""
CONFIG_CN_SPEECH_COMMAND_ID106=""
CONFIG_CN_SPEECH_COMMAND_ID107=""
CONFIG_CN_SPEECH_COMMAND_ID108=""
CONFIG_CN_SPEECH_COMMAND_ID109=""
CONFIG_CN_SPEECH_COMMAND_ID110=""
CONFIG_CN_SPEECH_COMMAND_ID111=""
CONFIG_CN_SPEECH_COMMAND_ID112=""
CONFIG_CN_SPEECH_COMMAND_ID113=""
CONFIG_CN_SPEECH_COMMAND_ID114=""
CONFIG_CN_SPEECH_COMMAND_ID115=""
CONFIG_CN_SPEECH_COMMAND_ID116=""
CONFIG_CN_SPEECH_COMMAND_ID117=""
CONFIG_CN_SPEECH_COMMAND_ID118=""
CONFIG_CN_SPEECH_COMMAND_ID119=""
CONFIG_CN_SPEECH_COMMAND_ID120=""
CONFIG_CN_SPEECH_COMMAND_ID121=""
CONFIG_CN_SPEECH_COMMAND_ID122=""
CONFIG_CN_SPEECH_COMMAND_ID123=""
CONFIG_CN_SPEECH_COMMAND_ID124=""
CONFIG_CN_SPEECH_COMMAND_ID125=""
CONFIG_CN_SPEECH_COMMAND_ID126=""
CONFIG_CN_SPEECH_COMMAND_ID127=""
CONFIG_CN_SPEECH_COMMAND_ID128=""
CONFIG_CN_SPEECH_COMMAND_ID129=""
CONFIG_CN_SPEECH_COMMAND_ID130=""
CONFIG_CN_SPEECH_COMMAND_ID131=""
CONFIG_CN_SPEECH_COMMAND_ID132=""
CONFIG_CN_SPEECH_COMMAND_ID133=""
CONFIG_CN_SPEECH_COMMAND_ID134=""
CONFIG_CN_SPEECH_COMMAND_ID135=""
CONFIG_CN_SPEECH_COMMAND_ID136=""
CONFIG_CN_SPEECH_COMMAND_ID137=""
CONFIG_CN_SPEECH_COMMAND_ID138=""
CONFIG_CN_SPEECH_COMMAND_ID139=""
CONFIG_CN_SPEECH_COMMAND_ID140=""
CONFIG_CN_SPEECH_COMMAND_ID141=""
CONFIG_CN_SPEECH_COMMAND_ID142=""
CONFIG_CN_SPEECH_COMMAND_ID143=""
CONFIG_CN_SPEECH_COMMAND_ID144=""
CONFIG_CN_SPEECH_COMMAND_ID145=""
CONFIG_CN_SPEECH_COMMAND_ID146=""
CONFIG_CN_SPEECH_COMMAND_ID147=""
CONFIG_CN_SPEECH_COMMAND_ID148=""
CONFIG_CN_SPEECH_COMMAND_ID149=""
CONFIG_CN_SPEECH_COMMAND_ID150=""
CONFIG_CN_SPEECH_COMMAND_ID151=""
CONFIG_CN_SPEECH_COMMAND_ID152=""
CONFIG_CN_SPEECH_COMMAND_ID153=""
CONFIG_CN_SPEECH_COMMAND_ID154=""
CONFIG_CN_SPEECH_COMMAND_ID155=""
CONFIG_CN_SPEECH_COMMAND_ID156=""
CONFIG_CN_SPEECH_COMMAND_ID157=""
CONFIG_CN_SPEECH_COMMAND_ID158=""
CONFIG_CN_SPEECH_COMMAND_ID159=""
CONFIG_CN_SPEECH_COMMAND_ID160=""
CONFIG_CN_SPEECH_COMMAND_ID161=""
CONFIG_CN_SPEECH_COMMAND_ID162=""
CONFIG_CN_SPEECH_COMMAND_ID163=""
CONFIG_CN_SPEECH_COMMAND_ID164=""
CONFIG_CN_SPEECH_COMMAND_ID165=""
CONFIG_CN_SPEECH_COMMAND_ID166=""
CONFIG_CN_SPEECH_COMMAND_ID167=""
CONFIG_CN_SPEECH_COMMAND_ID168=""
CONFIG_CN_SPEECH_COMMAND_ID169=""
CONFIG_CN_SPEECH_COMMAND_ID170=""
CONFIG_CN_SPEECH_COMMAND_ID171=""
CONFIG_CN_SPEECH_COMMAND_ID172=""
CONFIG_CN_SPEECH_COMMAND_ID173=""
CONFIG_CN_SPEECH_COMMAND_ID174=""
CONFIG_CN_SPEECH_COMMAND_ID175=""
CONFIG_CN_SPEECH_COMMAND_ID176=""
CONFIG_CN_SPEECH_COMMAND_ID177=""
CONFIG_CN_SPEECH_COMMAND_ID178=""
CONFIG_CN_SPEECH_COMMAND_ID179=""
CONFIG_CN_SPEECH_COMMAND_ID180=""
CONFIG_CN_SPEECH_COMMAND_ID181=""
CONFIG_CN_SPEECH_COMMAND_ID182=""
CONFIG_CN_SPEECH_COMMAND_ID183=""
CONFIG_CN_SPEECH_COMMAND_ID184=""
CONFIG_CN_SPEECH_COMMAND_ID185=""
CONFIG_CN_SPEECH_COMMAND_ID186=""
CONFIG_CN_SPEECH_COMMAND_ID187=""
CONFIG_CN_SPEECH_COMMAND_ID188=""
CONFIG_CN_SPEECH_COMMAND_ID189=""
CONFIG_CN_SPEECH_COMMAND_ID190=""
CONFIG_CN_SPEECH_COMMAND_ID191=""
CONFIG_CN_SPEECH_COMMAND_ID192=""
CONFIG_CN_SPEECH_COMMAND_ID193=""
CONFIG_CN_SPEECH_COMMAND_ID194=""
CONFIG_CN_SPEECH_COMMAND_ID195=""
CONFIG_CN_SPEECH_COMMAND_ID196=""
CONFIG_CN_SPEECH_COMMAND_ID197=""
CONFIG_CN_SPEECH_COMMAND_ID198=""
CONFIG_CN_SPEECH_COMMAND_ID199=""
# end of Add English speech commands
# end of ESP Speech Recognition



#
# Add English speech commands
#
CONFIG_EN_SPEECH_COMMAND_ID0="BaKLiT gZ BRiTcST"            # Backlight is brightest
CONFIG_EN_SPEECH_COMMAND_ID1="BaKLiT gZ DnRKcST"            # Backlight is darkest
CONFIG_EN_SPEECH_COMMAND_ID2="TkN eF jc BaKLiT"             # Turn off the backlight
CONFIG_EN_SPEECH_COMMAND_ID3="TkN nN jc BaKLiT"             # Turn on the backlight
CONFIG_EN_SPEECH_COMMAND_ID4="PLd MYoZgK"                   # Play music
CONFIG_EN_SPEECH_COMMAND_ID5=""
CONFIG_EN_SPEECH_COMMAND_ID6=""
CONFIG_EN_SPEECH_COMMAND_ID7=""
CONFIG_EN_SPEECH_COMMAND_ID8=""
CONFIG_EN_SPEECH_COMMAND_ID9=""
CONFIG_EN_SPEECH_COMMAND_ID10=""
CONFIG_EN_SPEECH_COMMAND_ID11=""
CONFIG_EN_SPEECH_COMMAND_ID12=""
CONFIG_EN_SPEECH_COMMAND_ID13=""
CONFIG_EN_SPEECH_COMMAND_ID14=""
CONFIG_EN_SPEECH_COMMAND_ID15=""
CONFIG_EN_SPEECH_COMMAND_ID16=""
CONFIG_EN_SPEECH_COMMAND_ID17=""
CONFIG_EN_SPEECH_COMMAND_ID18=""
CONFIG_EN_SPEECH_COMMAND_ID19=""
CONFIG_EN_SPEECH_COMMAND_ID20=""
CONFIG_EN_SPEECH_COMMAND_ID21=""
CONFIG_EN_SPEECH_COMMAND_ID22=""
CONFIG_EN_SPEECH_COMMAND_ID23=""
CONFIG_EN_SPEECH_COMMAND_ID24=""
CONFIG_EN_SPEECH_COMMAND_ID25=""
CONFIG_EN_SPEECH_COMMAND_ID26=""
CONFIG_EN_SPEECH_COMMAND_ID27=""
CONFIG_EN_SPEECH_COMMAND_ID28=""
CONFIG_EN_SPEECH_COMMAND_ID29=""
CONFIG_EN_SPEECH_COMMAND_ID30=""
CONFIG_EN_SPEECH_COMMAND_ID31=""
CONFIG_EN_SPEECH_COMMAND_ID32=""
CONFIG_EN_SPEECH_COMMAND_ID33=""
CONFIG_EN_SPEECH_COMMAND_ID34=""
CONFIG_EN_SPEECH_COMMAND_ID35=""
CONFIG_EN_SPEECH_COMMAND_ID36=""
CONFIG_EN_SPEECH_COMMAND_ID37=""
CONFIG_EN_SPEECH_COMMAND_ID38=""
CONFIG_EN_SPEECH_COMMAND_ID39=""
CONFIG_EN_SPEECH_COMMAND_ID40=""
CONFIG_EN_SPEECH_COMMAND_ID41=""
CONFIG_EN_SPEECH_COMMAND_ID42=""
CONFIG_EN_SPEECH_COMMAND_ID43=""
CONFIG_EN_SPEECH_COMMAND_ID44=""
CONFIG_EN_SPEECH_COMMAND_ID45=""
CONFIG_EN_SPEECH_COMMAND_ID46=""
CONFIG_EN_SPEECH_COMMAND_ID47=""
CONFIG_EN_SPEECH_COMMAND_ID48=""
CONFIG_EN_SPEECH_COMMAND_ID49=""
CONFIG_EN_SPEECH_COMMAND_ID50=""
CONFIG_EN_SPEECH_COMMAND_ID51=""
CONFIG_EN_SPEECH_COMMAND_ID52=""
CONFIG_EN_SPEECH_COMMAND_ID53=""
CONFIG_EN_SPEECH_COMMAND_ID54=""
CONFIG_EN_SPEECH_COMMAND_ID55=""
CONFIG_EN_SPEECH_COMMAND_ID56=""
CONFIG_EN_SPEECH_COMMAND_ID57=""
CONFIG_EN_SPEECH_COMMAND_ID58=""
CONFIG_EN_SPEECH_COMMAND_ID59=""
CONFIG_EN_SPEECH_COMMAND_ID60=""
CONFIG_EN_SPEECH_COMMAND_ID61=""
CONFIG_EN_SPEECH_COMMAND_ID62=""
CONFIG_EN_SPEECH_COMMAND_ID63=""
CONFIG_EN_SPEECH_COMMAND_ID64=""
CONFIG_EN_SPEECH_COMMAND_ID65=""
CONFIG_EN_SPEECH_COMMAND_ID66=""
CONFIG_EN_SPEECH_COMMAND_ID67=""
CONFIG_EN_SPEECH_COMMAND_ID68=""
CONFIG_EN_SPEECH_COMMAND_ID69=""
CONFIG_EN_SPEECH_COMMAND_ID70=""
CONFIG_EN_SPEECH_COMMAND_ID71=""
CONFIG_EN_SPEECH_COMMAND_ID72=""
CONFIG_EN_SPEECH_COMMAND_ID73=""
CONFIG_EN_SPEECH_COMMAND_ID74=""
CONFIG_EN_SPEECH_COMMAND_ID75=""
CONFIG_EN_SPEECH_COMMAND_ID76=""
CONFIG_EN_SPEECH_COMMAND_ID77=""
CONFIG_EN_SPEECH_COMMAND_ID78=""
CONFIG_EN_SPEECH_COMMAND_ID79=""
CONFIG_EN_SPEECH_COMMAND_ID80=""
CONFIG_EN_SPEECH_COMMAND_ID81=""
CONFIG_EN_SPEECH_COMMAND_ID82=""
CONFIG_EN_SPEECH_COMMAND_ID83=""
CONFIG_EN_SPEECH_COMMAND_ID84=""
CONFIG_EN_SPEECH_COMMAND_ID85=""
CONFIG_EN_SPEECH_COMMAND_ID86=""
CONFIG_EN_SPEECH_COMMAND_ID87=""
CONFIG_EN_SPEECH_COMMAND_ID88=""
CONFIG_EN_SPEECH_COMMAND_ID89=""
CONFIG_EN_SPEECH_COMMAND_ID90=""
CONFIG_EN_SPEECH_COMMAND_ID91=""
CONFIG_EN_SPEECH_COMMAND_ID92=""
CONFIG_EN_SPEECH_COMMAND_ID93=""
CONFIG_EN_SPEECH_COMMAND_ID94=""
CONFIG_EN_SPEECH_COMMAND_ID95=""
CONFIG_EN_SPEECH_COMMAND_ID96=""
CONFIG_EN_SPEECH_COMMAND_ID97=""
CONFIG_EN_SPEECH_COMMAND_ID98=""
CONFIG_EN_SPEECH_COMMAND_ID99=""
CONFIG_EN_SPEECH_COMMAND_ID100=""
CONFIG_EN_SPEECH_COMMAND_ID101=""
CONFIG_EN_SPEECH_COMMAND_ID102=""
CONFIG_EN_SPEECH_COMMAND_ID103=""
CONFIG_EN_SPEECH_COMMAND_ID104=""
CONFIG_EN_SPEECH_COMMAND_ID105=""
CONFIG_EN_SPEECH_COMMAND_ID106=""
CONFIG_EN_SPEECH_COMMAND_ID107=""
CONFIG_EN_SPEECH_COMMAND_ID108=""
CONFIG_EN_SPEECH_COMMAND_ID109=""
CONFIG_EN_SPEECH_COMMAND_ID110=""
CONFIG_EN_SPEECH_COMMAND_ID111=""
CONFIG_EN_SPEECH_COMMAND_ID112=""
CONFIG_EN_SPEECH_COMMAND_ID113=""
CONFIG_EN_SPEECH_COMMAND_ID114=""
CONFIG_EN_SPEECH_COMMAND_ID115=""
CONFIG_EN_SPEECH_COMMAND_ID116=""
CONFIG_EN_SPEECH_COMMAND_ID117=""
CONFIG_EN_SPEECH_COMMAND_ID118=""
CONFIG_EN_SPEECH_COMMAND_ID119=""
CONFIG_EN_SPEECH_COMMAND_ID120=""
CONFIG_EN_SPEECH_COMMAND_ID121=""
CONFIG_EN_SPEECH_COMMAND_ID122=""
CONFIG_EN_SPEECH_COMMAND_ID123=""
CONFIG_EN_SPEECH_COMMAND_ID124=""
CONFIG_EN_SPEECH_COMMAND_ID125=""
CONFIG_EN_SPEECH_COMMAND_ID126=""
CONFIG_EN_SPEECH_COMMAND_ID127=""
CONFIG_EN_SPEECH_COMMAND_ID128=""
CONFIG_EN_SPEECH_COMMAND_ID129=""
CONFIG_EN_SPEECH_COMMAND_ID130=""
CONFIG_EN_SPEECH_COMMAND_ID131=""
CONFIG_EN_SPEECH_COMMAND_ID132=""
CONFIG_EN_SPEECH_COMMAND_ID133=""
CONFIG_EN_SPEECH_COMMAND_ID134=""
CONFIG_EN_SPEECH_COMMAND_ID135=""
CONFIG_EN_SPEECH_COMMAND_ID136=""
CONFIG_EN_SPEECH_COMMAND_ID137=""
CONFIG_EN_SPEECH_COMMAND_ID138=""
CONFIG_EN_SPEECH_COMMAND_ID139=""
CONFIG_EN_SPEECH_COMMAND_ID140=""
CONFIG_EN_SPEECH_COMMAND_ID141=""
CONFIG_EN_SPEECH_COMMAND_ID142=""
CONFIG_EN_SPEECH_COMMAND_ID143=""
CONFIG_EN_SPEECH_COMMAND_ID144=""
CONFIG_EN_SPEECH_COMMAND_ID145=""
CONFIG_EN_SPEECH_COMMAND_ID146=""
CONFIG_EN_SPEECH_COMMAND_ID147=""
CONFIG_EN_SPEECH_COMMAND_ID148=""
CONFIG_EN_SPEECH_COMMAND_ID149=""
CONFIG_EN_SPEECH_COMMAND_ID150=""
CONFIG_EN_SPEECH_COMMAND_ID151=""
CONFIG_EN_SPEECH_COMMAND_ID152=""
CONFIG_EN_SPEECH_COMMAND_ID153=""
CONFIG_EN_SPEECH_COMMAND_ID154=""
CONFIG_EN_SPEECH_COMMAND_ID155=""
CONFIG_EN_SPEECH_COMMAND_ID156=""
CONFIG_EN_SPEECH_COMMAND_ID157=""
CONFIG_EN_SPEECH_COMMAND_ID158=""
CONFIG_EN_SPEECH_COMMAND_ID159=""
CONFIG_EN_SPEECH_COMMAND_ID160=""
CONFIG_EN_SPEECH_COMMAND_ID161=""
CONFIG_EN_SPEECH_COMMAND_ID162=""
CONFIG_EN_SPEECH_COMMAND_ID163=""
CONFIG_EN_SPEECH_COMMAND_ID164=""
CONFIG_EN_SPEECH_COMMAND_ID165=""
CONFIG_EN_SPEECH_COMMAND_ID166=""
CONFIG_EN_SPEECH_COMMAND_ID167=""
CONFIG_EN_SPEECH_COMMAND_ID168=""
CONFIG_EN_SPEECH_COMMAND_ID169=""
CONFIG_EN_SPEECH_COMMAND_ID170=""
CONFIG_EN_SPEECH_COMMAND_ID171=""
CONFIG_EN_SPEECH_COMMAND_ID172=""
CONFIG_EN_SPEECH_COMMAND_ID173=""
CONFIG_EN_SPEECH_COMMAND_ID174=""
CONFIG_EN_SPEECH_COMMAND_ID175=""
CONFIG_EN_SPEECH_COMMAND_ID176=""
CONFIG_EN_SPEECH_COMMAND_ID177=""
CONFIG_EN_SPEECH_COMMAND_ID178=""
CONFIG_EN_SPEECH_COMMAND_ID179=""
CONFIG_EN_SPEECH_COMMAND_ID180=""
CONFIG_EN_SPEECH_COMMAND_ID181=""
CONFIG_EN_SPEECH_COMMAND_ID182=""
CONFIG_EN_SPEECH_COMMAND_ID183=""
CONFIG_EN_SPEECH_COMMAND_ID184=""
CONFIG_EN_SPEECH_COMMAND_ID185=""
CONFIG_EN_SPEECH_COMMAND_ID186=""
CONFIG_EN_SPEECH_COMMAND_ID187=""
CONFIG_EN_SPEECH_COMMAND_ID188=""
CONFIG_EN_SPEECH_COMMAND_ID189=""
CONFIG_EN_SPEECH_COMMAND_ID190=""
CONFIG_EN_SPEECH_COMMAND_ID191=""
CONFIG_EN_SPEECH_COMMAND_ID192=""
CONFIG_EN_SPEECH_COMMAND_ID193=""
CONFIG_EN_SPEECH_COMMAND_ID194=""
CONFIG_EN_SPEECH_COMMAND_ID195=""
CONFIG_EN_SPEECH_COMMAND_ID196=""
CONFIG_EN_SPEECH_COMMAND_ID197=""
CONFIG_EN_SPEECH_COMMAND_ID198=""
CONFIG_EN_SPEECH_COMMAND_ID199=""
# end of Add English speech commands
# end of ESP Speech Recognition
```
